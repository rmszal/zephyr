## boards/arm/sobi_hci_dev/Kconfig.board
```kconfig
# SoBi HCI DEV board configuration

# Copyright (c) 2016 Linaro Limited.
# SPDX-License-Identifier: Apache-2.0

config BOARD_SOBI_HCI_DEV
	bool "SoBi HCI dev"
	depends on SOC_NRF51822_QFAC
```

## boards/arm/sobi_hci_dev/Kconfig.defconfig
```kconfig
# SoBi HCI DEV board configuration

# Copyright (c) 2016 Linaro Limited.
# SPDX-License-Identifier: Apache-2.0

if BOARD_SOBI_HCI_DEV

config BOARD
	default "sobi_hci_dev"

config BT_CTLR
	default BT

endif
```
